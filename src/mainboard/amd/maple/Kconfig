## src/mainboard/amd/maple/Kconfig
```kconfig
# SPDX-License-Identifier: GPL-2.0-only
# TODO: update for Maple

config BOARD_AMD_MAPLE_COMMON
	def_bool n
	select BOARD_ROMSIZE_KB_65536
	select EC_ACPI
	select SOC_AMD_COMMON_BLOCK_USE_ESPI if !SOC_AMD_COMMON_BLOCK_SIMNOW_BUILD
	select DRIVERS_PCIE_RTD3_DEVICE
	select DRIVERS_I2C_GENERIC
	select SOC_AMD_COMMON_BLOCK_ESPI_RETAIN_PORT80_EN if !SOC_AMD_COMMON_BLOCK_SIMNOW_BUILD
	select SOC_AMD_COMMON_BLOCK_SIMNOW_SUPPORTED
	select SPI_FLASH_EXIT_4_BYTE_ADDR_MODE

config BOARD_AMD_MAPLE_STRIX_HALO
	select BOARD_AMD_MAPLE_COMMON
	select SOC_AMD_STRIX_HALO

if BOARD_AMD_MAPLE_COMMON

config FMDFILE
	default "src/mainboard/amd/maple/board.fmd"

config MAINBOARD_DIR
	default "amd/maple"

config MAINBOARD_PART_NUMBER
	default "Maple_StrixHalo"

config DEVICETREE
	default "devicetree.cb"

config MAPLE_HAVE_MCHP_FW
	bool "Have Microchip EC firmware?"
	default n

config AMD_SOC_CONSOLE_UART
	default y if !SOC_AMD_COMMON_BLOCK_SIMNOW_BUILD

config MAPLE_MCHP_FW_FILE
	string "Microchip EC firmware file"
	depends on MAPLE_HAVE_MCHP_FW
	default "3rdparty/blobs/mainboard/amd/maple/StxhComboEC.bin"
	help
	  The EC firmware blob is at the EC_BODY FMAP region of the firmware image.

config ENABLE_SSD1_MAPLE
	bool "Enable M.2 SSD1 Slot"
	help
	  Enable M.2 SSD1 Slot. For Strix Halo SoC this will downgrade
	  PCIe x8 slot to x4.

choice
	prompt "WLAN / WWAN Lane Selection"
	default ENABLE_WLANx1_WWANx1_MAPLE
	help
	  Enable 2 Lanes WLAN or 2 Lanes WWAN or 1 Lane WLAN and 1 Lane WWAN.

config ENABLE_WLANx1_WWANx1_MAPLE
	bool "Enable 1 Lane WLAN and 1 Lane WWAN"

config ENABLE_WLANx2_WWANx0_MAPLE
	bool "Enable 2 Lanes WLAN (no WWAN)"

config ENABLE_WLANx0_WWANx2_MAPLE
	bool "Enable 2 Lanes WWAN (no WLAN)"
endchoice

if !EM100	# EM100 defaults in soc/amd/common/blocks/spi/Kconfig
config EFS_SPI_READ_MODE
	default 3	# Quad IO (1-1-4)

config EFS_SPI_SPEED
	default 0	# 66MHz

config EFS_SPI_MICRON_FLAG
	default 0

config NORMAL_READ_SPI_SPEED
	default 1	# 33MHz

config ALT_SPI_SPEED
	default 1	# 33MHz

config TPM_SPI_SPEED
	default 1	# 33MHz

endif # !EM100

endif # BOARD_AMD_MAPLE_COMMON
```

## src/mainboard/amd/maple/Kconfig.name
```kconfig
comment "Maple"

config BOARD_AMD_MAPLE_STRIX_HALO
	bool "->  Maple for Strix Halo SoC"
```

## src/mainboard/asrock/h370m-itx_ac/Kconfig
```kconfig
if BOARD_ASROCK_H370M_ITX

config BOARD_SPECIFIC_OPTIONS
	def_bool y
	select BOARD_ROMSIZE_KB_16384
	select CRB_TPM
	select HAVE_ACPI_RESUME
	select HAVE_ACPI_TABLES
	select HAVE_CMOS_DEFAULT
	select HAVE_INTEL_PTT
	select HAVE_OPTION_TABLE
	select INTEL_GMA_HAVE_VBT
	select INTEL_INT15
	select MAINBOARD_HAS_LIBGFXINIT
	select MAINBOARD_USES_IFD_GBE_REGION
	select MEMORY_MAPPED_TPM
	select SOC_INTEL_CANNONLAKE_PCH_H
	select SOC_INTEL_COFFEELAKE
	select SUPERIO_NUVOTON_COMMON_COM_A
	select SUPERIO_NUVOTON_NCT5539D

config MAINBOARD_DIR
	default "asrock/h370m-itx_ac"

config MAINBOARD_PART_NUMBER
	default "H370M-ITX/ac"

config DIMM_SPD_SIZE
	default 512 #DDR4

config DIMM_MAX
	default 2

config TPM_PIRQ
	hex
	default 0x10 # GPP_A7/PIRQA#

config CBFS_SIZE
	default 0xa00000 # 12mb available

endif
```

## src/mainboard/cwwk/adl/Kconfig.name
```kconfig
## SPDX-License-Identifier: GPL-2.0-or-later

config BOARD_CWWK_CW_ADL_4L_V1
	bool "CW-ADL-4L-V1.0"

config BOARD_CWWK_CW_ADLNTB_1C2L_V3
	bool "CW-ADLNTB-1C2L-V3.0"

config BOARD_CWWK_CW_TWINTB_1C2L_V1
	bool "CW-TWINTB-1C2L-V1.0"
```

## src/soc/intel/common/feature/cbfs_preload/Kconfig
```kconfig
## SPDX-License-Identifier: GPL-2.0-only

config SOC_INTEL_COMMON_FEATURE_CBFS_PRELOAD
	bool
	help
	  Include common CBFS preloading implementation for Intel SoCs. This
	  driver consolidates the nearly identical CBFS preloading logic across
	  multiple Intel platform generations. It preloads FSP-S, the payload,
	  and DSDT prior to device enumeration, taking chipset lockdown mode
	  into account.
```

## src/soc/intel/common/feature/elog/Kconfig
```kconfig
## SPDX-License-Identifier: GPL-2.0-only

config SOC_INTEL_COMMON_FEATURE_ELOG
	bool
	help
	  Include common PCH elog implementation for modern Intel client SoCs.
	  This consolidates the nearly identical elog.c across multiple Intel
	  platform generations. Platform-specific differences are handled via
	  sub-options below.

if SOC_INTEL_COMMON_FEATURE_ELOG

config SOC_INTEL_COMMON_FEATURE_ELOG_SMBUS_WAKE
	bool
	help
	  Enable SMBUS wake source logging. Select this if the platform's
	  PCH includes an SMBUS controller that can generate a wake event.

endif
```
